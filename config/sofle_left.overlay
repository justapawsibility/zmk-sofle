/ {
    behaviors {
        split_bat: split_battery_type {
            compatible = "zmk,behavior-macro";
            label = "SPLIT_BATTERY_TYPE";
            #binding-cells = <0>;
        };
    };
};
